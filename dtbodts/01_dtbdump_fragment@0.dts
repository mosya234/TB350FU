/dts-v1/;

/ {

	__fixups__ {
		accdet = "/fragment@45:target:0";
		android = "/fragment@10:target:0";
		camera_af_hw_node = "/fragment@25:target:0";
		chosen = "/fragment@7:target:0", "/fragment@30/__overlay__/mouse@60:bootmode:0", "/fragment@31/__overlay__/keyboard@61:bootmode:0", "/fragment@37/__overlay__:bootmode:0";
		dispsys_config = "/fragment@15:target:0";
		dsi0 = "/fragment@16:target:0";
		dsi_te = "/fragment@49:target:0";
		dvfsrc_vcore = "/fragment@37/__overlay__:dvfsrc-vcore-supply:0", "/fragment@41/__overlay__:dvfsrc-vcore-supply:0";
		gpio = "/fragment@44:target:0";
		gpio_usage_mapping = "/fragment@43:target:0";
		gps = "/fragment@19:target:0";
		i2c0 = "/fragment@30:target:0";
		i2c2 = "/fragment@2:target:0", "/fragment@3:target:0", "/fragment@24:target:0";
		i2c4 = "/fragment@5:target:0", "/fragment@26:target:0", "/fragment@35:target:0";
		i2c5 = "/fragment@17:target:0", "/fragment@28:target:0";
		i2c6 = "/fragment@21:target:0", "/fragment@29:target:0";
		i2c7 = "/fragment@4:target:0";
		i2c8 = "/fragment@31:target:0";
		infracfg_rst = "/fragment@37/__overlay__:resets:0";
		kd_camera_hw1 = "/fragment@1:target:0";
		keypad = "/fragment@52:target:0";
		md1_sim1_hot_plug_eint = "/fragment@50:target:0";
		md1_sim2_hot_plug_eint = "/fragment@51:target:0";
		mddriver = "/fragment@34:target:0";
		mmc0 = "/fragment@41:target:0";
		mmc1 = "/fragment@37:target:0", "/fragment@38:target:0";
		mt6358_vcn18_reg = "/fragment@37/__overlay__:vqmmc-supply:0", "/fragment@39:target:0";
		mt6358_vmc_reg = "/fragment@41/__overlay__:vqmmc-supply:0";
		mt6358_vmch_reg = "/fragment@41/__overlay__:vmmc-supply:0";
		mtee_svp = "/fragment@27:target:0";
		mtk_composite_v4l2_1 = "/fragment@23:target:0";
		mtk_leds = "/fragment@12:target:0";
		mtkfb = "/fragment@14:target:0";
		odm = "/fragment@9:target:0";
		pio = "/fragment@0:target:0", "/fragment@9/__overlay__/dock_pogo:typec_in_det:0", "/fragment@9/__overlay__/dock_pogo:pogo_in_det:0", "/fragment@9/__overlay__/dock_pogo:pogo_chg_en:0", "/fragment@9/__overlay__/pogo_int:interrupt-parent:0", "/fragment@9/__overlay__/typec_int:interrupt-parent:0", "/fragment@13:target:0", "/fragment@16/__overlay__/panel1@0:pm-enable-gpios:0", "/fragment@16/__overlay__/panel1@0:reset-gpios:0", "/fragment@16/__overlay__/panel1@0:bias-gpios:0", "/fragment@16/__overlay__/panel1@0:bias-gpios:12", "/fragment@16/__overlay__/panel2@0:pm-enable-gpios:0", "/fragment@16/__overlay__/panel2@0:reset-gpios:0", "/fragment@16/__overlay__/panel2@0:bias-gpios:0", "/fragment@16/__overlay__/panel2@0:bias-gpios:12", "/fragment@16/__overlay__/panel3@0:pm-enable-gpios:0", "/fragment@16/__overlay__/panel3@0:reset-gpios:0", "/fragment@16/__overlay__/panel3@0:bias-gpios:0", "/fragment@16/__overlay__/panel3@0:bias-gpios:12", "/fragment@18:target:0", "/fragment@20/__overlay__/himax_touch@0:interrupt-parent:0", "/fragment@20/__overlay__/himax_touch@0:himax,irq-gpio:0", "/fragment@20/__overlay__/himax_touch@0:himax,rst-gpio:0", "/fragment@20/__overlay__/himax_touch@0:himax,lcm-id0:0", "/fragment@20/__overlay__/himax_touch@0:himax,lcm-id1:0", "/fragment@22:target:0", "/fragment@26/__overlay__/aw9610x_sar@12:irq-gpio:0", "/fragment@28/__overlay__/aw883xx_smartpa@37:reset-gpio:0", "/fragment@28/__overlay__/aw883xx_smartpa@36:reset-gpio:0", "/fragment@29/__overlay__/aw883xx_smartpa@34:reset-gpio:0", "/fragment@29/__overlay__/aw883xx_smartpa@35:reset-gpio:0", "/fragment@30/__overlay__/mouse@60:mcu_en_gpio:0", "/fragment@30/__overlay__/mouse@60:mcu_rst_gpio:0", "/fragment@30/__overlay__/mouse@60:interrupt-parent:0", "/fragment@31/__overlay__/keyboard@61:interrupt-parent:0", "/fragment@31/__overlay__/keyboard@61:mcu_en_gpio:0", "/fragment@31/__overlay__/keyboard@61:mcu_rst_gpio:0", "/fragment@31/__overlay__/keyboard@61:pogo_sw_en_gpio:0", "/fragment@36/__overlay__:reset-gpios:0", "/fragment@37/__overlay__:eint-gpios:0", "/fragment@38/__overlay__/mediatek,mt7921-wifi:interrupt-parent:0", "/fragment@40:target:0", "/fragment@41/__overlay__:cd-gpios:0", "/fragment@42:target:0", "/fragment@43/__overlay__:GPIO_SIM1_HOT_PLUG:0", "/fragment@43/__overlay__:GPIO_SIM1_SCLK:0", "/fragment@43/__overlay__:GPIO_SIM1_SRST:0", "/fragment@43/__overlay__:GPIO_SIM1_SIO:0", "/fragment@43/__overlay__:GPIO_SIM2_SRST:0", "/fragment@43/__overlay__:GPIO_SIM2_SIO:0", "/fragment@43/__overlay__:GPIO_FDD_BAND_SUPPORT_DETECT_3RD_PIN:0", "/fragment@43/__overlay__:GPIO_FDD_BAND_SUPPORT_DETECT_1ST_PIN:0", "/fragment@43/__overlay__:GPIO_FDD_BAND_SUPPORT_DETECT_2ND_PIN:0", "/fragment@45/__overlay__:interrupt-parent:0", "/fragment@46/__overlay__:interrupt-parent:0", "/fragment@47/__overlay__:interrupt-parent:0", "/fragment@47/__overlay__:deb-gpios:0", "/fragment@48/__overlay__:interrupt-parent:0", "/fragment@49/__overlay__:interrupt-parent:0";
		product_region = "/fragment@8:target:0";
		rt5133_gpio1 = "/fragment@25/__overlay__:camaf_m2_pmic-supply:0", "/fragment@25/__overlay__:camaf_m3_pmic-supply:0";
		rt5133_ldo3 = "/fragment@25/__overlay__:camaf_m1_pmic-supply:0";
		smart_pa = "/fragment@46:target:0";
		sound = "/fragment@33:target:0";
		spi0 = "/fragment@20:target:0";
		swtp = "/fragment@47:target:0";
		thermal_zones = "/fragment@6:target:0";
		touch = "/fragment@48:target:0";
		utos = "/fragment@11:target:0", "/fragment@32:target:0";
		wifi_pwrseq = "/fragment@36:target:0", "/fragment@37/__overlay__:mmc-pwrseq:0";
	};

	__local_fixups__ {

		fragment@1 {

			__overlay__ {
				pinctrl-0 = <0x0>;
				pinctrl-1 = <0x0>;
				pinctrl-10 = <0x0>;
				pinctrl-11 = <0x0>;
				pinctrl-12 = <0x0>;
				pinctrl-13 = <0x0>;
				pinctrl-14 = <0x0>;
				pinctrl-2 = <0x0>;
				pinctrl-3 = <0x0>;
				pinctrl-4 = <0x0>;
				pinctrl-5 = <0x0>;
				pinctrl-6 = <0x0>;
				pinctrl-7 = <0x0>;
				pinctrl-8 = <0x0>;
				pinctrl-9 = <0x0>;
			};
		};

		fragment@14 {

			__overlay__ {
				pinctrl-0 = <0x0>;
				pinctrl-1 = <0x0>;
				pinctrl-2 = <0x0>;
				pinctrl-3 = <0x0>;
				pinctrl-4 = <0x0>;
			};
		};

		fragment@15 {

			__overlay__ {
				pinctrl-0 = <0x0>;
				pinctrl-1 = <0x0>;
				pinctrl-2 = <0x0>;
			};
		};

		fragment@16 {

			__overlay__ {

				panel1@0 {

					port {

						endpoint {
							remote-endpoint = <0x0>;
						};
					};
				};

				panel2@0 {

					port {

						endpoint {
							remote-endpoint = <0x0>;
						};
					};
				};

				panel3@0 {

					port {

						endpoint {
							remote-endpoint = <0x0>;
						};
					};
				};

				ports {

					port {

						endpoint {
							remote-endpoint = <0x0>;
						};
					};
				};
			};
		};

		fragment@19 {

			__overlay__ {
				pinctrl-0 = <0x0>;
				pinctrl-1 = <0x0>;
				pinctrl-2 = <0x0>;
				pinctrl-3 = <0x0>;
				pinctrl-4 = <0x0>;
				pinctrl-5 = <0x0>;
				pinctrl-6 = <0x0>;
			};
		};

		fragment@21 {

			__overlay__ {

				lm3643@63 {
					pinctrl-0 = <0x0>;
					pinctrl-1 = <0x0>;
					pinctrl-2 = <0x0>;

					flash@0 {

						port@0 {

							endpoint {
								remote-endpoint = <0x0>;
							};
						};
					};

					flash@1 {

						port@1 {

							endpoint {
								remote-endpoint = <0x0>;
							};
						};
					};
				};
			};
		};

		fragment@23 {

			__overlay__ {

				port@0 {

					endpoint {
						remote-endpoint = <0x0>;
					};
				};

				port@1 {

					endpoint {
						remote-endpoint = <0x0>;
					};
				};
			};
		};

		fragment@33 {

			__overlay__ {

				mediatek,speaker-codec {
					sound-dai = <0x0 0x4 0x8 0xc>;
				};
			};
		};

		fragment@36 {

			__overlay__ {
				pinctrl-0 = <0x0>;
			};
		};

		fragment@37 {

			__overlay__ {
				pinctrl-0 = <0x0>;
				pinctrl-1 = <0x0>;
				pinctrl-2 = <0x0>;
				pinctrl-3 = <0x0>;
				vmmc-supply = <0x0>;
			};
		};

		fragment@41 {

			__overlay__ {
				pinctrl-0 = <0x0>;
				pinctrl-1 = <0x0>;
			};
		};

		fragment@6 {

			__overlay__ {

				camera_main {
					thermal-sensors = <0x0>;
				};

				camera_main_two {
					thermal-sensors = <0x0>;
				};

				camera_sub {
					thermal-sensors = <0x0>;
				};
			};
		};
	};

	__symbols__ {
		aw883xx_smartpa_0 = "/fragment@28/__overlay__/aw883xx_smartpa@37";
		aw883xx_smartpa_1 = "/fragment@28/__overlay__/aw883xx_smartpa@36";
		aw883xx_smartpa_2 = "/fragment@29/__overlay__/aw883xx_smartpa@34";
		aw883xx_smartpa_3 = "/fragment@29/__overlay__/aw883xx_smartpa@35";
		camera_main = "/fragment@6/__overlay__/camera_main";
		camera_main_af_mtk = "/fragment@3/__overlay__/camera_main_af@72";
		camera_main_mtk = "/fragment@3/__overlay__/camera_main@1a";
		camera_main_three_af_mtk = "/fragment@24/__overlay__/camera_main_three_af@0c";
		camera_main_two = "/fragment@6/__overlay__/camera_main_two";
		camera_main_two_af_mtk = "/fragment@24/__overlay__/camera_main_two_af@0d";
		camera_main_two_mtk = "/fragment@2/__overlay__/camera_main_two@10";
		camera_pins_cam0_mclk_2ma = "/fragment@0/__overlay__/camera_pins_cam0_mclk_2ma";
		camera_pins_cam0_mclk_4ma = "/fragment@0/__overlay__/camera_pins_cam0_mclk_4ma";
		camera_pins_cam0_mclk_6ma = "/fragment@0/__overlay__/camera_pins_cam0_mclk_6ma";
		camera_pins_cam0_mclk_8ma = "/fragment@0/__overlay__/camera_pins_cam0_mclk_8ma";
		camera_pins_cam0_mclk_off = "/fragment@0/__overlay__/camera_pins_cam0_mclk_off";
		camera_pins_cam0_rst_0 = "/fragment@0/__overlay__/cam0@0";
		camera_pins_cam0_rst_1 = "/fragment@0/__overlay__/cam0@1";
		camera_pins_cam1_mclk_2ma = "/fragment@0/__overlay__/camera_pins_cam1_mclk_2ma";
		camera_pins_cam1_mclk_4ma = "/fragment@0/__overlay__/camera_pins_cam1_mclk_4ma";
		camera_pins_cam1_mclk_6ma = "/fragment@0/__overlay__/camera_pins_cam1_mclk_6ma";
		camera_pins_cam1_mclk_8ma = "/fragment@0/__overlay__/camera_pins_cam1_mclk_8ma";
		camera_pins_cam1_mclk_off = "/fragment@0/__overlay__/camera_pins_cam1_mclk_off";
		camera_pins_cam1_rst_0 = "/fragment@0/__overlay__/cam1@0";
		camera_pins_cam1_rst_1 = "/fragment@0/__overlay__/cam1@1";
		camera_pins_default = "/fragment@0/__overlay__/camdefault";
		camera_sub = "/fragment@6/__overlay__/camera_sub";
		camera_sub_mtk = "/fragment@4/__overlay__/camera_sub@1a";
		dsi_out = "/fragment@16/__overlay__/ports/port/endpoint";
		fl_core_0 = "/fragment@21/__overlay__/lm3643@63/flash@0/port@0/endpoint";
		fl_core_1 = "/fragment@21/__overlay__/lm3643@63/flash@1/port@1/endpoint";
		flashlight_0 = "/fragment@23/__overlay__/port@0/endpoint";
		flashlight_1 = "/fragment@23/__overlay__/port@1/endpoint";
		gps_l1_lna_pins_dsp_ctrl = "/fragment@18/__overlay__/gps_l1_lna@1";
		gps_l1_lna_pins_oh = "/fragment@18/__overlay__/gps_l1_lna@2";
		gps_l1_lna_pins_ol = "/fragment@18/__overlay__/gps_l1_lna@0";
		gps_l5_lna_pins_dsp_ctrl = "/fragment@18/__overlay__/gps_l5_lna@1";
		gps_l5_lna_pins_oh = "/fragment@18/__overlay__/gps_l5_lna@2";
		gps_l5_lna_pins_ol = "/fragment@18/__overlay__/gps_l5_lna@0";
		gps_pins_default = "/fragment@18/__overlay__/gps_default";
		lm3643 = "/fragment@21/__overlay__/lm3643@63";
		lm3643_pins_default = "/fragment@22/__overlay__/default";
		lm3643_pins_hwen_high = "/fragment@22/__overlay__/hwen_high";
		lm3643_pins_hwen_low = "/fragment@22/__overlay__/hwen_low";
		mmc0_pins_default = "/fragment@42/__overlay__/mmc0default";
		mmc0_pins_uhs = "/fragment@42/__overlay__/mmc0@0";
		mmc1_pins_dat1 = "/fragment@40/__overlay__/mmc1dat1";
		mmc1_pins_default = "/fragment@40/__overlay__/mmc1default";
		mmc1_pins_eint = "/fragment@40/__overlay__/mmc1eint";
		mmc1_pins_uhs = "/fragment@40/__overlay__/mmc1@0";
		mtee = "/fragment@27/__overlay__/MTEE";
		mtk_camera_eeprom0 = "/fragment@3/__overlay__/camera_eeprom0@50";
		mtk_camera_eeprom1 = "/fragment@4/__overlay__/camera_eeprom1@51";
		mtk_camera_eeprom2 = "/fragment@2/__overlay__/camera_eeprom2@51";
		mtkfb_pins_lcm_dsi_te = "/fragment@13/__overlay__/lcm_dsi_te";
		mtkfb_pins_lcm_led_en0 = "/fragment@13/__overlay__/lcm_led_en0_gpio";
		mtkfb_pins_lcm_led_en1 = "/fragment@13/__overlay__/lcm_led_en1_gpio";
		mtkfb_pins_lcm_rst_out0_gpio = "/fragment@13/__overlay__/lcm_rst_out0_gpio";
		mtkfb_pins_lcm_rst_out1_gpio = "/fragment@13/__overlay__/lcm_rst_out1_gpio";
		panel_in1 = "/fragment@16/__overlay__/panel1@0/port/endpoint";
		panel_in2 = "/fragment@16/__overlay__/panel2@0/port/endpoint";
		panel_in3 = "/fragment@16/__overlay__/panel3@0/port/endpoint";
		sdio_fixed_3v3 = "/fragment@9/__overlay__/fixedregulator@0";
		spk = "/fragment@29/__overlay__/speaker_amp@5c";
		svp = "/fragment@27/__overlay__/SecureVideoPath";
		wifi_pins_pwrseq = "/fragment@40/__overlay__/wifipwrseq";
	};

	fragment@0 {
		target = <0xffffffff>;

		__overlay__ {

			cam0@0 {
				phandle = <0x2>;

				pins_cmd_dat {
					output-low;
					pinmux = <0x1400>;
					slew-rate = <0x1>;
				};
			};

			cam0@1 {
				phandle = <0x3>;

				pins_cmd_dat {
					output-high;
					pinmux = <0x1400>;
					slew-rate = <0x1>;
				};
			};

			cam1@0 {
				phandle = <0x4>;

				pins_cmd_dat {
					output-low;
					pinmux = <0x1000>;
					slew-rate = <0x1>;
				};
			};

			cam1@1 {
				phandle = <0x5>;

				pins_cmd_dat {
					output-high;
					pinmux = <0x1000>;
					slew-rate = <0x1>;
				};
			};

			camdefault {
				phandle = <0x1>;
			};

			camera_pins_cam0_mclk_2ma {
				phandle = <0x7>;

				pins_cmd_dat {
					drive-strength = <0x0>;
					pinmux = <0x8001>;
				};
			};

			camera_pins_cam0_mclk_4ma {
				phandle = <0x8>;

				pins_cmd_dat {
					drive-strength = <0x1>;
					pinmux = <0x8001>;
				};
			};

			camera_pins_cam0_mclk_6ma {
				phandle = <0x9>;

				pins_cmd_dat {
					drive-strength = <0x2>;
					pinmux = <0x8001>;
				};
			};

			camera_pins_cam0_mclk_8ma {
				phandle = <0xa>;

				pins_cmd_dat {
					drive-strength = <0x3>;
					pinmux = <0x8001>;
				};
			};

			camera_pins_cam0_mclk_off {
				phandle = <0x6>;

				pins_cmd_dat {
					drive-strength = <0x1>;
					pinmux = <0x8000>;
				};
			};

			camera_pins_cam1_mclk_2ma {
				phandle = <0xc>;

				pins_cmd_dat {
					drive-strength = <0x0>;
					pinmux = <0x7e01>;
				};
			};

			camera_pins_cam1_mclk_4ma {
				phandle = <0xd>;

				pins_cmd_dat {
					drive-strength = <0x1>;
					pinmux = <0x7e01>;
				};
			};

			camera_pins_cam1_mclk_6ma {
				phandle = <0xe>;

				pins_cmd_dat {
					drive-strength = <0x2>;
					pinmux = <0x7e01>;
				};
			};

			camera_pins_cam1_mclk_8ma {
				phandle = <0xf>;

				pins_cmd_dat {
					drive-strength = <0x3>;
					pinmux = <0x7e01>;
				};
			};

			camera_pins_cam1_mclk_off {
				phandle = <0xb>;

				pins_cmd_dat {
					drive-strength = <0x1>;
					pinmux = <0x7e00>;
				};
			};
		};
	};

	fragment@1 {
		target = <0xffffffff>;

		__overlay__ {
			cam0_enable_sensor = "hi1339_mipi_raw ov13b10main_mipi_raw";
			cam0_pin_mclk = "mclk";
			cam0_pin_rst = "gpio";
			cam0_pin_vcama = "wl2868";
			cam0_pin_vcama1 = "wl2868";
			cam0_pin_vcamd = "wl2868";
			cam0_pin_vcamio = "wl2868";
			cam1_enable_sensor = "s5k4h7_mipi_raw sc800cs_mipi_raw";
			cam1_pin_mclk = "mclk";
			cam1_pin_rst = "gpio";
			cam1_pin_vcama = "wl2868";
			cam1_pin_vcama1 = "wl2868";
			cam1_pin_vcamd = "wl2868";
			cam1_pin_vcamio = "wl2868";
			pinctrl-0 = <0x1>;
			pinctrl-1 = <0x2>;
			pinctrl-10 = <0xb>;
			pinctrl-11 = <0xc>;
			pinctrl-12 = <0xd>;
			pinctrl-13 = <0xe>;
			pinctrl-14 = <0xf>;
			pinctrl-2 = <0x3>;
			pinctrl-3 = <0x4>;
			pinctrl-4 = <0x5>;
			pinctrl-5 = <0x6>;
			pinctrl-6 = <0x7>;
			pinctrl-7 = <0x8>;
			pinctrl-8 = <0x9>;
			pinctrl-9 = <0xa>;
			pinctrl-names = "default", "cam0_rst0", "cam0_rst1", "cam1_rst0", "cam1_rst1", "cam0_mclk_off", "cam0_mclk_2mA", "cam0_mclk_4mA", "cam0_mclk_6mA", "cam0_mclk_8mA", "cam1_mclk_off", "cam1_mclk_2mA", "cam1_mclk_4mA", "cam1_mclk_6mA", "cam1_mclk_8mA";
			status = "okay";
		};
	};

	fragment@10 {
		target = <0xffffffff>;

		__overlay__ {
			hardware = "mt8781";
		};
	};

	fragment@11 {
		target = <0xffffffff>;

		__overlay__ {
			microtrust,real-drv = <0x1>;
		};
	};

	fragment@12 {
		target = <0xffffffff>;

		__overlay__ {
			compatible = "mediatek,disp-leds";

			backlight {
				led_mode = <0x4>;
				pwm_config = <0x0 0x1 0x0 0x0 0x0>;
			};
		};
	};

	fragment@13 {
		target = <0xffffffff>;

		__overlay__ {

			lcm_dsi_te {
				phandle = <0x17>;

				pins_cmd_dat {
					pinmux = <0x5301>;
				};
			};

			lcm_led_en0_gpio {
				phandle = <0x14>;

				pins_cmd_dat {
					output-low;
					pinmux = <0x5700>;
					slew-rate = <0x1>;
				};
			};

			lcm_led_en1_gpio {
				phandle = <0x13>;

				pins_cmd_dat {
					output-high;
					pinmux = <0x5700>;
					slew-rate = <0x1>;
				};
			};

			lcm_rst_out0_gpio {
				phandle = <0x16>;

				pins_cmd_dat {
					output-low;
					pinmux = <0x5500>;
					slew-rate = <0x1>;
				};
			};

			lcm_rst_out1_gpio {
				phandle = <0x15>;

				pins_cmd_dat {
					output-high;
					pinmux = <0x5500>;
					slew-rate = <0x1>;
				};
			};
		};
	};

	fragment@14 {
		target = <0xffffffff>;

		__overlay__ {
			pinctrl-0 = <0x13>;
			pinctrl-1 = <0x14>;
			pinctrl-2 = <0x15>;
			pinctrl-3 = <0x16>;
			pinctrl-4 = <0x17>;
			pinctrl-names = "lcm_led_en1_gpio", "lcm_led_en0_gpio", "lcm_rst_out1_gpio", "lcm_rst_out0_gpio", "mode_te_te";
			status = "okay";
		};
	};

	fragment@15 {
		target = <0xffffffff>;

		__overlay__ {
			pinctrl-0 = <0x15>;
			pinctrl-1 = <0x16>;
			pinctrl-2 = <0x17>;
			pinctrl-names = "lcm_rst_out1_gpio", "lcm_rst_out0_gpio", "mode_te_te";
			status = "okay";
		};
	};

	fragment@16 {
		target = <0xffffffff>;

		__overlay__ {
			#address-cells = <0x1>;
			#size-cells = <0x0>;
			status = "okay";

			panel1@0 {
				bias-gpios = <0xffffffff 0x52 0x0 0xffffffff 0x51 0x0>;
				compatible = "boe,hx83102j,vdo,120hz";
				pinctrl-names = "default";
				pm-enable-gpios = <0xffffffff 0x57 0x0>;
				reg = <0x0>;
				reset-gpios = <0xffffffff 0x55 0x0>;

				port {

					endpoint {
						phandle = <0x19>;
						remote-endpoint = <0x18>;
					};
				};
			};

			panel2@0 {
				bias-gpios = <0xffffffff 0x52 0x0 0xffffffff 0x51 0x0>;
				compatible = "tianma,hx83102j,vdo,120hz";
				pinctrl-names = "default";
				pm-enable-gpios = <0xffffffff 0x57 0x0>;
				reg = <0x1>;
				reset-gpios = <0xffffffff 0x55 0x0>;

				port {

					endpoint {
						phandle = <0x3b>;
						remote-endpoint = <0x18>;
					};
				};
			};

			panel3@0 {
				bias-gpios = <0xffffffff 0x52 0x0 0xffffffff 0x51 0x0>;
				compatible = "boe-2,hx83102j,vdo,120hz";
				pinctrl-names = "default";
				pm-enable-gpios = <0xffffffff 0x57 0x0>;
				reg = <0x2>;
				reset-gpios = <0xffffffff 0x55 0x0>;

				port {

					endpoint {
						phandle = <0x3c>;
						remote-endpoint = <0x18>;
					};
				};
			};

			ports {

				port {

					endpoint {
						phandle = <0x18>;
						remote-endpoint = <0x19>;
					};
				};
			};
		};
	};

	fragment@17 {
		target = <0xffffffff>;

		__overlay__ {

			ktz8866@11 {
				compatible = "ktz,ktz8866";
				id = <0x5>;
				reg = <0x11>;
				status = "okay";
			};
		};
	};

	fragment@18 {
		target = <0xffffffff>;

		__overlay__ {

			gps_default {
				phandle = <0x1a>;
			};

			gps_l1_lna@0 {
				phandle = <0x1b>;

				pins_cmd_dat {
					output-low;
					pinmux = <0x1900>;
				};
			};

			gps_l1_lna@1 {
				phandle = <0x1c>;

				pins_cmd_dat {
					pinmux = <0x1902>;
				};
			};

			gps_l1_lna@2 {
				phandle = <0x1d>;

				pins_cmd_dat {
					output-high;
					pinmux = <0x1900>;
				};
			};

			gps_l5_lna@0 {
				phandle = <0x1e>;

				pins_cmd_dat {
					output-low;
					pinmux = <0x1a00>;
				};
			};

			gps_l5_lna@1 {
				phandle = <0x1f>;

				pins_cmd_dat {
					pinmux = <0x1a02>;
				};
			};

			gps_l5_lna@2 {
				phandle = <0x20>;

				pins_cmd_dat {
					output-high;
					pinmux = <0x1a00>;
				};
			};
		};
	};

	fragment@19 {
		target = <0xffffffff>;

		__overlay__ {
			pinctrl-0 = <0x1a>;
			pinctrl-1 = <0x1b>;
			pinctrl-2 = <0x1c>;
			pinctrl-3 = <0x1d>;
			pinctrl-4 = <0x1e>;
			pinctrl-5 = <0x1f>;
			pinctrl-6 = <0x20>;
			pinctrl-names = "default", "gps_l1_lna_disable", "gps_l1_lna_dsp_ctrl", "gps_l1_lna_enable", "gps_l5_lna_disable", "gps_l5_lna_dsp_ctrl", "gps_l5_lna_enable";
			status = "okay";
		};
	};

	fragment@2 {
		target = <0xffffffff>;

		__overlay__ {
			#address-cells = <0x1>;
			#size-cells = <0x0>;
			clock-frequency = <0xf4240>;
			status = "okay";

			camera_eeprom2@51 {
				compatible = "mediatek,camera_eeprom";
				phandle = <0x34>;
				reg = <0x51>;
				status = "okay";
			};

			camera_main_two@10 {
				#thermal-sensor-cells = <0x0>;
				compatible = "mediatek,camera_main_two";
				phandle = <0x12>;
				reg = <0x10>;
				status = "okay";
			};
		};
	};

	fragment@20 {
		target = <0xffffffff>;

		__overlay__ {
			#address-cells = <0x1>;
			#size-cells = <0x0>;
			status = "okay";

			himax_touch@0 {
				compatible = "himax,hxcommon";
				himax,display-coords = <0x4b0 0x7d0>;
				himax,irq-gpio = <0xffffffff 0x36 0x2800>;
				himax,lcm-id0 = <0xffffffff 0x6d 0x0>;
				himax,lcm-id1 = <0xffffffff 0x62 0x0>;
				himax,panel-coords = <0x0 0x4b0 0x0 0x7d0>;
				himax,rst-gpio = <0xffffffff 0x2a 0x0>;
				interrupt-parent = <0xffffffff>;
				reg = <0x0>;
				report_type = <0x1>;
				spi-cpha;
				spi-max-frequency = <0x895440>;
			};
		};
	};

	fragment@21 {
		target = <0xffffffff>;

		__overlay__ {

			lm3643@63 {
				#cooling-cells = <0x2>;
				compatible = "mediatek,lm3643";
				phandle = <0x3d>;
				pinctrl-0 = <0x21>;
				pinctrl-1 = <0x22>;
				pinctrl-2 = <0x23>;
				pinctrl-names = "default", "hwen_high", "hwen_low";
				reg = <0x63>;
				status = "okay";

				flash@0 {
					ct = <0x0>;
					part = <0x0>;
					reg = <0x0>;
					type = <0x0>;

					port@0 {

						endpoint {
							phandle = <0x26>;
							remote-endpoint = <0x24>;
						};
					};
				};

				flash@1 {
					ct = <0x1>;
					part = <0x0>;
					reg = <0x1>;
					type = <0x0>;

					port@1 {

						endpoint {
							phandle = <0x27>;
							remote-endpoint = <0x25>;
						};
					};
				};
			};
		};
	};

	fragment@22 {
		target = <0xffffffff>;

		__overlay__ {

			default {
				phandle = <0x21>;
			};

			hwen_high {
				phandle = <0x22>;

				pins_cmd_dat {
					output-high;
					pinmux = <0x9d00>;
					slew-rate = <0x1>;
				};
			};

			hwen_low {
				phandle = <0x23>;

				pins_cmd_dat {
					output-low;
					pinmux = <0x9d00>;
					slew-rate = <0x1>;
				};
			};
		};
	};

	fragment@23 {
		target = <0xffffffff>;

		__overlay__ {

			port@0 {

				endpoint {
					phandle = <0x24>;
					remote-endpoint = <0x26>;
				};
			};

			port@1 {

				endpoint {
					phandle = <0x25>;
					remote-endpoint = <0x27>;
				};
			};
		};
	};

	fragment@24 {
		target = <0xffffffff>;

		__overlay__ {

			camera_main_three_af@0c {
				compatible = "mediatek,camera_main_three_af";
				phandle = <0x3f>;
				reg = <0xc>;
				status = "okay";
			};

			camera_main_two_af@0d {
				compatible = "mediatek,camera_main_two_af";
				phandle = <0x3e>;
				reg = <0xd>;
				status = "okay";
			};
		};
	};

	fragment@25 {
		target = <0xffffffff>;

		__overlay__ {
			camaf_m1_pmic-supply = <0xffffffff>;
			camaf_m2_pmic-supply = <0xffffffff>;
			camaf_m3_pmic-supply = <0xffffffff>;
			status = "okay";
		};
	};

	fragment@26 {
		target = <0xffffffff>;

		__overlay__ {
			status = "okay";

			aw9610x_sar@12 {
				aw9610x,using-firmware;
				channel_use_flag = <0x1f>;
				compatible = "awinic,aw9610x_sar";
				irq-gpio = <0xffffffff 0xe 0x0>;
				reg = <0x12>;
				sar-num = <0x0>;
				status = "okay";
			};
		};
	};

	fragment@27 {
		target = <0xffffffff>;

		__overlay__ {

			MTEE {
				compatible = "mediatek,mtk_svp_on_mtee_support";
				phandle = <0x40>;
			};

			SecureVideoPath {
				compatible = "mediatek,mtk_sec_video_path_support";
				phandle = <0x41>;
			};
		};
	};

	fragment@28 {
		target = <0xffffffff>;

		__overlay__ {
			clock-frequency = <0x61a80>;

			aw883xx_smartpa@36 {
				#sound-dai-cells = <0x0>;
				compatible = "awinic,aw883xx_smartpa";
				phandle = <0x29>;
				re-max = <0x9c40>;
				re-min = <0x3e8>;
				reg = <0x36>;
				reset-gpio = <0xffffffff 0x15 0x0>;
				sound-channel = <0x1>;
				spin-data = "l r r l";
				spin-mode = "reg_spin";
				status = "okay";
			};

			aw883xx_smartpa@37 {
				#sound-dai-cells = <0x0>;
				compatible = "awinic,aw883xx_smartpa";
				phandle = <0x28>;
				re-max = <0x9c40>;
				re-min = <0x3e8>;
				reg = <0x37>;
				reset-gpio = <0xffffffff 0xf 0x0>;
				sound-channel = <0x0>;
				spin-data = "l l r r";
				spin-mode = "reg_spin";
				status = "okay";
			};
		};
	};

	fragment@29 {
		target = <0xffffffff>;

		__overlay__ {
			clock-frequency = <0x61a80>;

			aw883xx_smartpa@34 {
				#sound-dai-cells = <0x0>;
				compatible = "awinic,aw883xx_smartpa";
				phandle = <0x2a>;
				re-max = <0x9c40>;
				re-min = <0x3e8>;
				reg = <0x34>;
				reset-gpio = <0xffffffff 0x13 0x0>;
				sound-channel = <0x2>;
				spin-data = "r r l l";
				spin-mode = "reg_spin";
				status = "okay";
			};

			aw883xx_smartpa@35 {
				#sound-dai-cells = <0x0>;
				compatible = "awinic,aw883xx_smartpa";
				phandle = <0x2b>;
				re-max = <0x9c40>;
				re-min = <0x3e8>;
				reg = <0x35>;
				reset-gpio = <0xffffffff 0x11 0x0>;
				sound-channel = <0x3>;
				spin-data = "r l l r";
				spin-mode = "reg_spin";
				status = "okay";
			};

			speaker_amp@5c {
				#sound-dai-cells = <0x0>;
				compatible = "richtek,rt5512";
				phandle = <0x42>;
				reg = <0x5c>;
				sound-name-prefix = "Left";
				status = "okay";
			};
		};
	};

	fragment@3 {
		target = <0xffffffff>;

		__overlay__ {
			#address-cells = <0x1>;
			#size-cells = <0x0>;
			clock-frequency = <0xf4240>;
			status = "okay";

			camera_eeprom0@50 {
				compatible = "mediatek,camera_eeprom";
				phandle = <0x35>;
				reg = <0x50>;
				status = "okay";
			};

			camera_main@1a {
				#thermal-sensor-cells = <0x0>;
				compatible = "mediatek,camera_main";
				phandle = <0x10>;
				reg = <0x1a>;
				status = "okay";
			};

			camera_main_af@72 {
				compatible = "mediatek,camera_main_af";
				phandle = <0x36>;
				reg = <0x72>;
				status = "okay";
			};
		};
	};

	fragment@30 {
		target = <0xffffffff>;

		__overlay__ {
			clock-frequency = <0xf4240>;
			status = "okay";

			mouse@60 {
				bootmode = <0xffffffff>;
				compatible = "hid-over-i2c";
				hid-descr-addr = <0x1>;
				interrupt-names = "keyboard_tp_irq";
				interrupt-parent = <0xffffffff>;
				interrupts = <0x6b 0x8 0x6b 0x0>;
				mcu_en_gpio = <0xffffffff 0x9e 0x0>;
				mcu_rst_gpio = <0xffffffff 0x6e 0x0>;
				post-power-on-delay-ms = <0x64>;
				reg = <0x60>;
			};
		};
	};

	fragment@31 {
		target = <0xffffffff>;

		__overlay__ {
			clock-frequency = <0x61a80>;
			status = "okay";

			keyboard@61 {
				bootmode = <0xffffffff>;
				compatible = "hid-over-i2c";
				hid-descr-addr = <0x1>;
				interrupt-names = "keyboard_kb_irq";
				interrupt-parent = <0xffffffff>;
				interrupts = <0x6c 0x8 0x6c 0x0>;
				mcu_en_gpio = <0xffffffff 0x9e 0x0>;
				mcu_rst_gpio = <0xffffffff 0x6e 0x0>;
				pogo_sw_en_gpio = <0xffffffff 0x67 0x0>;
				post-power-on-delay-ms = <0x64>;
				reg = <0x61>;
			};
		};
	};

	fragment@32 {
		target = <0xffffffff>;

		__overlay__ {
			microtrust,real-drv = <0x1>;
		};
	};

	fragment@33 {
		target = <0xffffffff>;

		__overlay__ {
			mediatek,spk-i2s = <0x1 0x2>;

			mediatek,speaker-codec {
				sound-dai = <0x28 0x29 0x2a 0x2b>;
			};
		};
	};

	fragment@34 {
		target = <0xffffffff>;

		__overlay__ {
			ref_args = "md_disable";
		};
	};

	fragment@35 {
		target = <0xffffffff>;

		__overlay__ {
			#address-cells = <0x1>;
			#size-cells = <0x0>;
			clock-frequency = <0x61a80>;

			i2c_camera_ldo {
				compatible = "mediatek,i2c_camera_ldo";
				reg = <0x2f>;
				status = "okay";
			};

			i2c_camera_ldo2 {
				compatible = "mediatek,i2c_camera_ldo2";
				reg = <0x35>;
				status = "okay";
			};
		};
	};

	fragment@36 {
		target = <0xffffffff>;

		__overlay__ {
			pinctrl-0 = <0x2c>;
			pinctrl-names = "default";
			post-power-on-delay-ms = <0xc8>;
			reset-gpios = <0xffffffff 0x7f 0x1>;
			status = "okay";
		};
	};

	fragment@37 {
		target = <0xffffffff>;

		__overlay__ {
			bootmode = <0xffffffff>;
			bus-width = <0x4>;
			cap-sd-highspeed;
			cap-sdio-async-irq;
			cap-sdio-irq;
			compatible = "mediatek,mt6779-mmc";
			dvfsrc-vcore-supply = <0xffffffff>;
			eint-gpios = <0xffffffff 0x4a 0x0>;
			host-index = <0x1>;
			keep-power-in-suspend;
			max-frequency = <0xbebc200>;
			max-vcore-volt = <0xb1008>;
			mmc-pwrseq = <0xffffffff>;
			no-mmc;
			no-sd;
			non-removable;
			pinctrl-0 = <0x2d>;
			pinctrl-1 = <0x2e>;
			pinctrl-2 = <0x2f>;
			pinctrl-3 = <0x30>;
			pinctrl-names = "default", "state_uhs", "state_eint", "state_dat1";
			reset-names = "hrst";
			resets = <0xffffffff 0x4>;
			sd-uhs-sdr104;
			sd-uhs-sdr12;
			sd-uhs-sdr25;
			sd-uhs-sdr50;
			status = "okay";
			vmmc-supply = <0x31>;
			vqmmc-supply = <0xffffffff>;
		};
	};

	fragment@38 {
		target = <0xffffffff>;

		__overlay__ {

			mediatek,mt7921-wifi {
				compatible = "mediatek,mediatek_wifi_ctrl";
				interrupt-parent = <0xffffffff>;
				interrupts = <0x22 0x2>;
				status = "okay";
			};
		};
	};

	fragment@39 {
		target = <0xffffffff>;

		__overlay__ {
			regulator-always-on;
			regulator-max-microvolt = <0x1b7740>;
			regulator-min-microvolt = <0x1b7740>;
		};
	};

	fragment@4 {
		target = <0xffffffff>;

		__overlay__ {
			#address-cells = <0x1>;
			#size-cells = <0x0>;
			clock-frequency = <0x61a80>;
			status = "okay";

			camera_eeprom1@51 {
				compatible = "mediatek,camera_eeprom";
				phandle = <0x37>;
				reg = <0x51>;
				status = "okay";
			};

			camera_sub@1a {
				#thermal-sensor-cells = <0x0>;
				compatible = "mediatek,camera_sub";
				phandle = <0x11>;
				reg = <0x1a>;
				status = "okay";
			};
		};
	};

	fragment@40 {
		target = <0xffffffff>;

		__overlay__ {

			mmc1@0 {
				phandle = <0x2e>;

				pins_clk {
					bias-pull-down = <0x66>;
					drive-strength = <0x6>;
					pinmux = <0x4701>;
				};

				pins_cmd_dat {
					bias-pull-up = <0x65>;
					drive-strength = <0x6>;
					input-enable;
					pinmux = <0x4901 0x4a01 0x4b01 0x4c01 0x4801>;
				};

				pins_wow {
					bias-disable;
					input-enable;
					pinmux = <0x2200>;
				};
			};

			mmc1dat1 {
				phandle = <0x30>;

				pins_dat1 {
					bias-pull-up = <0x65>;
					drive-strength = <0x6>;
					pinmux = <0x4a01>;
				};
			};

			mmc1default {
				phandle = <0x2d>;

				pins_clk {
					bias-pull-down = <0x66>;
					drive-strength = <0x6>;
					pinmux = <0x4701>;
				};

				pins_cmd_dat {
					bias-pull-up = <0x65>;
					drive-strength = <0x6>;
					input-enable;
					pinmux = <0x4901 0x4a01 0x4b01 0x4c01 0x4801>;
				};

				pins_wow {
					bias-disable;
					input-enable;
					pinmux = <0x2200>;
				};
			};

			mmc1eint {
				phandle = <0x2f>;

				pins_dat1 {
					bias-pull-up = <0x65>;
					input-enable;
					pinmux = <0x4a00>;
				};
			};

			wifipwrseq {
				phandle = <0x2c>;

				pins_wifi_enable {
					drive-strength = <0x6>;
					output-low;
					pinmux = <0x7f00>;
				};
			};
		};
	};

	fragment@41 {
		target = <0xffffffff>;

		__overlay__ {
			bus-width = <0x4>;
			cap-sd-highspeed;
			cd-debounce-delay-ms = <0x0>;
			cd-gpios = <0xffffffff 0x7 0x0>;
			dvfsrc-vcore-supply = <0xffffffff>;
			host-index = <0x0>;
			max-frequency = <0xbebc200>;
			no-mmc;
			no-sdio;
			ocr-voltage = <0x30000>;
			pinctrl-0 = <0x32>;
			pinctrl-1 = <0x33>;
			pinctrl-names = "default", "state_uhs";
			req-vcore = <0x9eb10>;
			sd-uhs-ddr50;
			sd-uhs-sdr104;
			sd-uhs-sdr12;
			sd-uhs-sdr25;
			sd-uhs-sdr50;
			status = "okay";
			vmmc-supply = <0xffffffff>;
			vqmmc-supply = <0xffffffff>;
		};
	};

	fragment@42 {
		target = <0xffffffff>;

		__overlay__ {

			mmc0@0 {
				phandle = <0x33>;

				pins_clk {
					bias-pull-down = <0x66>;
					drive-strength = <0x4>;
					pinmux = <0x3701>;
				};

				pins_cmd_dat {
					bias-pull-up = <0x65>;
					drive-strength = <0x4>;
					input-enable;
					pinmux = <0x3a01 0x3b01 0x3c01 0x3d01 0x3801>;
				};

				pins_ds {
					bias-pull-down = <0x66>;
					drive-strength = <0x3>;
					pinmux = <0x3601>;
				};

				pins_rst {
					bias-pull-up = <0x64>;
					drive-strength = <0x4>;
					pinmux = <0x3901>;
				};
			};

			mmc0default {
				phandle = <0x32>;

				pins_clk {
					bias-pull-down = <0x66>;
					drive-strength = <0x4>;
					pinmux = <0x3701>;
				};

				pins_cmd_dat {
					bias-pull-up = <0x65>;
					drive-strength = <0x4>;
					input-enable;
					pinmux = <0x3a01 0x3b01 0x3c01 0x3d01 0x3801>;
				};

				pins_rst {
					bias-pull-up = <0x64>;
					drive-strength = <0x4>;
					pinmux = <0x3901>;
				};
			};
		};
	};

	fragment@43 {
		target = <0xffffffff>;

		__overlay__ {
			GPIO_FDD_BAND_SUPPORT_DETECT_1ST_PIN = <0xffffffff 0x97 0x0>;
			GPIO_FDD_BAND_SUPPORT_DETECT_2ND_PIN = <0xffffffff 0x98 0x0>;
			GPIO_FDD_BAND_SUPPORT_DETECT_3RD_PIN = <0xffffffff 0x96 0x0>;
			GPIO_SIM1_HOT_PLUG = <0xffffffff 0x17 0x0>;
			GPIO_SIM1_SCLK = <0xffffffff 0x4d 0x0>;
			GPIO_SIM1_SIO = <0xffffffff 0x4f 0x0>;
			GPIO_SIM1_SRST = <0xffffffff 0x4e 0x0>;
			GPIO_SIM2_SIO = <0xffffffff 0x52 0x0>;
			GPIO_SIM2_SRST = <0xffffffff 0x51 0x0>;
		};
	};

	fragment@44 {
		target = <0xffffffff>;

		__overlay__ {
			gpio_init_default = <0x0 0x0 0x0 0x0 0x1 0x1 0x1 0x1 0x1 0x0 0x0 0x0 0x0 0x1 0x2 0x1 0x0 0x0 0x0 0x0 0x1 0x3 0x1 0x0 0x0 0x0 0x0 0x1 0x4 0x1 0x0 0x0 0x1 0x0 0x1 0x5 0x0 0x0 0x0 0x1 0x1 0x1 0x6 0x0 0x1 0x0 0x1 0x0 0x1 0x7 0x0 0x0 0x0 0x1 0x1 0x1 0x8 0x0 0x0 0x0 0x1 0x0 0x1 0x9 0x0 0x1 0x1 0x1 0x0 0x0 0xa 0x0 0x0 0x0 0x1 0x0 0x1 0xb 0x0 0x0 0x0 0x1 0x1 0x1 0xc 0x0 0x0 0x0 0x1 0x1 0x1 0xd 0x6 0x0 0x0 0x1 0x0 0x1 0xe 0x6 0x0 0x0 0x1 0x0 0x0 0xf 0x0 0x1 0x0 0x1 0x0 0x0 0x10 0x0 0x1 0x0 0x1 0x0 0x0 0x11 0x0 0x0 0x0 0x1 0x0 0x0 0x12 0x0 0x1 0x0 0x1 0x0 0x0 0x13 0x0 0x1 0x0 0x1 0x0 0x0 0x14 0x0 0x1 0x0 0x1 0x0 0x0 0x15 0x0 0x1 0x0 0x1 0x0 0x0 0x16 0x0 0x1 0x0 0x1 0x0 0x0 0x17 0x1 0x0 0x0 0x1 0x1 0x0 0x18 0x0 0x1 0x0 0x1 0x0 0x0 0x19 0x2 0x0 0x0 0x1 0x0 0x1 0x1a 0x2 0x0 0x0 0x1 0x0 0x1 0x1b 0x0 0x0 0x0 0x1 0x1 0x1 0x1c 0x1 0x0 0x0 0x1 0x1 0x1 0x1d 0x1 0x0 0x0 0x0 0x0 0x1 0x1e 0x1 0x0 0x0 0x0 0x0 0x1 0x1f 0x1 0x0 0x0 0x0 0x0 0x1 0x20 0x1 0x0 0x0 0x0 0x0 0x1 0x21 0x1 0x0 0x0 0x1 0x0 0x1 0x22 0x6 0x0 0x0 0x1 0x0 0x0 0x23 0x0 0x1 0x0 0x1 0x0 0x0 0x24 0x6 0x0 0x0 0x0 0x0 0x0 0x25 0x6 0x0 0x0 0x1 0x0 0x0 0x26 0x2 0x0 0x0 0x0 0x0 0x1 0x27 0x2 0x0 0x0 0x0 0x0 0x1 0x28 0x2 0x0 0x0 0x0 0x0 0x1 0x29 0x2 0x0 0x0 0x0 0x0 0x1 0x2a 0x0 0x1 0x0 0x1 0x0 0x1 0x2b 0x0 0x1 0x1 0x1 0x0 0x0 0x2c 0x0 0x1 0x0 0x1 0x0 0x0 0x2d 0x4 0x0 0x0 0x0 0x0 0x0 0x2e 0x6 0x0 0x0 0x1 0x0 0x0 0x2f 0x6 0x0 0x0 0x1 0x0 0x0 0x30 0x6 0x0 0x0 0x0 0x0 0x0 0x31 0x6 0x0 0x0 0x1 0x0 0x0 0x32 0x1 0x0 0x0 0x0 0x0 0x1 0x33 0x1 0x0 0x0 0x0 0x0 0x1 0x34 0x1 0x0 0x0 0x0 0x0 0x1 0x35 0x1 0x0 0x0 0x1 0x0 0x1 0x36 0x0 0x0 0x0 0x1 0x1 0x1 0x42 0x1 0x0 0x0 0x1 0x1 0x0 0x43 0x0 0x1 0x0 0x1 0x0 0x1 0x44 0x0 0x1 0x0 0x1 0x0 0x1 0x45 0x0 0x0 0x0 0x1 0x1 0x1 0x4d 0x1 0x0 0x0 0x0 0x0 0x1 0x4e 0x1 0x0 0x0 0x0 0x0 0x1 0x4f 0x1 0x0 0x0 0x1 0x1 0x1 0x50 0x0 0x1 0x0 0x1 0x0 0x1 0x51 0x0 0x1 0x1 0x1 0x0 0x1 0x52 0x0 0x1 0x1 0x1 0x0 0x1 0x53 0x1 0x0 0x0 0x1 0x0 0x1 0x54 0x1 0x0 0x0 0x0 0x0 0x1 0x55 0x0 0x1 0x0 0x1 0x0 0x1 0x56 0x0 0x1 0x0 0x1 0x0 0x0 0x57 0x0 0x1 0x1 0x1 0x0 0x0 0x58 0x0 0x1 0x0 0x1 0x0 0x0 0x59 0x0 0x1 0x0 0x1 0x0 0x0 0x5a 0x0 0x0 0x0 0x1 0x0 0x0 0x5b 0x0 0x1 0x0 0x1 0x0 0x0 0x5c 0x0 0x1 0x0 0x1 0x0 0x0 0x5d 0x0 0x0 0x0 0x0 0x0 0x0 0x5e 0x1 0x0 0x0 0x1 0x0 0x0 0x5f 0x0 0x1 0x0 0x1 0x0 0x0 0x60 0x1 0x0 0x0 0x1 0x0 0x0 0x61 0x1 0x0 0x0 0x1 0x0 0x0 0x62 0x0 0x0 0x0 0x1 0x0 0x0 0x63 0x1 0x0 0x0 0x1 0x0 0x0 0x64 0x0 0x0 0x0 0x1 0x0 0x0 0x65 0x0 0x0 0x0 0x1 0x0 0x0 0x66 0x1 0x0 0x0 0x1 0x0 0x0 0x67 0x2 0x0 0x0 0x1 0x0 0x0 0x68 0x2 0x0 0x0 0x0 0x0 0x0 0x69 0x0 0x1 0x0 0x1 0x0 0x0 0x6a 0x1 0x0 0x0 0x1 0x0 0x0 0x6b 0x0 0x0 0x0 0x1 0x0 0x0 0x6c 0x0 0x0 0x0 0x1 0x0 0x0 0x6d 0x0 0x0 0x0 0x1 0x0 0x0 0x6e 0x0 0x1 0x0 0x1 0x0 0x0 0x6f 0x0 0x0 0x0 0x0 0x0 0x0 0x70 0x1 0x0 0x0 0x0 0x0 0x0 0x71 0x1 0x0 0x0 0x1 0x0 0x0 0x72 0x1 0x0 0x0 0x0 0x0 0x0 0x73 0x1 0x0 0x0 0x1 0x0 0x0 0x74 0x1 0x0 0x0 0x0 0x0 0x0 0x75 0x1 0x0 0x0 0x1 0x0 0x0 0x76 0x1 0x0 0x0 0x0 0x0 0x0 0x77 0x1 0x0 0x0 0x1 0x0 0x0 0x78 0x1 0x0 0x0 0x0 0x0 0x0 0x79 0x1 0x0 0x0 0x1 0x0 0x0 0x7a 0x1 0x0 0x0 0x0 0x0 0x0 0x7b 0x1 0x0 0x0 0x0 0x0 0x0 0x7c 0x1 0x0 0x0 0x1 0x0 0x0 0x7d 0x1 0x0 0x0 0x1 0x0 0x0 0x7e 0x1 0x0 0x0 0x1 0x0 0x0 0x7f 0x0 0x1 0x0 0x1 0x0 0x0 0x80 0x1 0x0 0x0 0x1 0x0 0x0 0x81 0x1 0x0 0x0 0x1 0x0 0x0 0x82 0x1 0x0 0x0 0x1 0x1 0x1 0x83 0x1 0x0 0x0 0x1 0x1 0x1 0x84 0x1 0x0 0x0 0x1 0x1 0x0 0x85 0x1 0x0 0x0 0x1 0x1 0x0 0x86 0x1 0x0 0x0 0x1 0x1 0x1 0x87 0x1 0x0 0x0 0x1 0x1 0x1 0x88 0x7 0x0 0x0 0x1 0x1 0x1 0x89 0x7 0x0 0x0 0x0 0x0 0x1 0x8a 0x1 0x0 0x0 0x1 0x1 0x1 0x8b 0x1 0x0 0x0 0x1 0x1 0x1 0x8c 0x1 0x0 0x0 0x1 0x1 0x1 0x8d 0x1 0x0 0x0 0x1 0x1 0x1 0x8e 0x1 0x0 0x0 0x1 0x1 0x1 0x8f 0x1 0x0 0x0 0x1 0x1 0x1 0x90 0x1 0x0 0x0 0x1 0x1 0x1 0x91 0x1 0x0 0x0 0x1 0x1 0x1 0x92 0x1 0x0 0x0 0x1 0x1 0x1 0x93 0x1 0x0 0x0 0x1 0x1 0x1 0x94 0x2 0x0 0x0 0x1 0x1 0x1 0x95 0x2 0x0 0x0 0x1 0x1 0x1 0x96 0x0 0x0 0x0 0x0 0x0 0x0 0x97 0x0 0x0 0x0 0x0 0x0 0x0 0x98 0x0 0x0 0x0 0x0 0x0 0x0 0x99 0x0 0x0 0x0 0x1 0x0 0x1 0x9a 0x0 0x1 0x0 0x1 0x0 0x1 0x9b 0x0 0x1 0x0 0x1 0x0 0x1 0x9c 0x0 0x1 0x0 0x1 0x0 0x1 0x9d 0x0 0x1 0x0 0x1 0x0 0x1 0x9e 0x0 0x1 0x1 0x0 0x0 0x1 0x9f 0x0 0x1 0x1 0x1 0x0 0x0 0xa0 0x1 0x0 0x0 0x0 0x0 0x1 0xa1 0x1 0x0 0x0 0x0 0x0 0x1 0xa2 0x1 0x0 0x0 0x0 0x0 0x1 0xa3 0x1 0x0 0x0 0x1 0x0 0x1 0xa4 0x1 0x0 0x0 0x0 0x0 0x1 0xa5 0x1 0x0 0x0 0x0 0x0 0x1 0xa6 0x1 0x0 0x0 0x0 0x0 0x1 0xa7 0x1 0x0 0x0 0x1 0x0 0x1 0xa8 0x1 0x0 0x0 0x0 0x0 0x0 0xa9 0x1 0x0 0x0 0x0 0x0 0x1 0xaa 0x1 0x0 0x0 0x0 0x0 0x1 0xab 0x1 0x0 0x0 0x0 0x0 0x1 0xac 0x1 0x0 0x0 0x0 0x0 0x1 0xad 0x1 0x0 0x0 0x1 0x0 0x1 0xae 0x1 0x0 0x0 0x1 0x0 0x1 0xaf 0x1 0x0 0x0 0x1 0x0 0x1 0xb0 0x1 0x0 0x0 0x1 0x0 0x1 0xb1 0x0 0x0 0x0 0x1 0x0 0x0 0xb2 0x0 0x0 0x0 0x1 0x0 0x0 0xb3 0x0 0x0 0x0 0x1 0x0 0x0 0xb4 0x0 0x0 0x0 0x1 0x0 0x0 0xb5 0x0 0x0 0x0 0x1 0x0 0x0 0xb6 0x0 0x0 0x0 0x1 0x0 0x0 0xb7 0x0 0x0 0x0 0x1 0x0 0x0 0xb8 0x0 0x0 0x0 0x1 0x0 0x0 0xb9 0x0 0x0 0x0 0x1 0x0 0x0 0xba 0x1 0x0 0x0 0x1 0x1 0x1 0xbb 0x1 0x0 0x0 0x1 0x1 0x1 0xbc 0x0 0x0 0x0 0x1 0x0 0x0 0xbd 0x0 0x0 0x0 0x1 0x0 0x0 0xbe 0x0 0x0 0x0 0x1 0x0 0x0 0xbf 0x0 0x0 0x0 0x1 0x0 0x0 0xc0 0x0 0x0 0x0 0x1 0x0 0x0 0xc1 0x0 0x0 0x0 0x1 0x0 0x0 0xc2 0x0 0x0 0x0 0x1 0x0 0x0 0xc3 0x0 0x0 0x0 0x1 0x0 0x0 0xc4 0x0 0x0 0x0 0x1 0x0 0x0 0xc5 0x0 0x0 0x0 0x1 0x0 0x0 0xc6 0x0 0x0 0x0 0x1 0x0 0x0 0xc7 0x0 0x0 0x0 0x1 0x0 0x0 0xc8 0x0 0x0 0x0 0x1 0x0 0x0 0xc9 0x0 0x0 0x0 0x1 0x0 0x0 0xca 0x0 0x0 0x0 0x1 0x0 0x0 0xcb 0x0 0x0 0x0 0x1 0x0 0x0 0xcc 0x0 0x0 0x0 0x1 0x0 0x0 0xcd 0x0 0x0 0x0 0x1 0x0 0x0 0xce 0x0 0x0 0x0 0x1 0x0 0x0 0xcf 0x0 0x0 0x0 0x1 0x0 0x0 0xd0 0x0 0x0 0x0 0x1 0x0 0x0 0xd1 0x0 0x0 0x0 0x1 0x0 0x0 0xd2 0x0 0x0 0x0 0x1 0x0 0x0 0xd3 0x0 0x0 0x0 0x1 0x0 0x0 0xd4 0x0 0x0 0x0 0x1 0x0 0x0 0xd5 0x0 0x0 0x0 0x1 0x0 0x0 0xd6 0x0 0x0 0x0 0x1 0x0 0x0 0xd7 0x0 0x0 0x0 0x1 0x0 0x0 0xd8 0x0 0x0 0x0 0x1 0x0 0x0 0xd9 0x0 0x0 0x0 0x1 0x0 0x0 0xda 0x0 0x0 0x0 0x1 0x0 0x0 0xdb 0x0 0x0 0x0 0x1 0x0 0x0 0xdc 0x0 0x0 0x0 0x1 0x0 0x0 0xdd 0x0 0x0 0x0 0x1 0x0 0x0>;
		};
	};

	fragment@45 {
		target = <0xffffffff>;

		__overlay__ {
			interrupt-parent = <0xffffffff>;
			interrupts = <0x0 0x8>;
			status = "okay";
		};
	};

	fragment@46 {
		target = <0xffffffff>;

		__overlay__ {
			interrupt-parent = <0xffffffff>;
			interrupts = <0x6 0x8>;
			status = "okay";
		};
	};

	fragment@47 {
		target = <0xffffffff>;

		__overlay__ {
			deb-gpios = <0xffffffff 0x1b 0x0>;
			debounce = <0x7d000>;
			interrupt-parent = <0xffffffff>;
			interrupts = <0x1b 0x8>;
			status = "okay";
		};
	};

	fragment@48 {
		target = <0xffffffff>;

		__overlay__ {
			interrupt-parent = <0xffffffff>;
			interrupts = <0x36 0x8>;
			status = "okay";
		};
	};

	fragment@49 {
		target = <0xffffffff>;

		__overlay__ {
			interrupt-parent = <0xffffffff>;
			interrupts = <0x53 0x1>;
			status = "okay";
		};
	};

	fragment@5 {
		target = <0xffffffff>;

		__overlay__ {

			aw36518@63 {
				compatible = "awinic,aw36518";
				reg = <0x63>;
				status = "okay";
			};
		};
	};

	fragment@50 {
		target = <0xffffffff>;

		__overlay__ {
			compatible = "mediatek,md1_sim1_hot_plug_eint-eint";
			debounce = <0x0 0x2710>;
			dedicated = <0x0 0x0>;
			interrupts = <0x0 0x4>;
			sockettype = <0x0 0x0>;
			src_pin = <0x0 0x1>;
			status = "okay";
		};
	};

	fragment@51 {
		target = <0xffffffff>;

		__overlay__ {
			compatible = "mediatek,md1_sim2_hot_plug_eint-eint";
			debounce = <0x1 0x2710>;
			dedicated = <0x1 0x0>;
			interrupts = <0x1 0x4>;
			sockettype = <0x1 0x0>;
			src_pin = <0x1 0x2>;
			status = "okay";
		};
	};

	fragment@52 {
		target = <0xffffffff>;

		__overlay__ {
			mediatek,hw-dl-key0 = <0x0>;
			mediatek,hw-dl-key1 = <0x11>;
			mediatek,hw-dl-key2 = <0x8>;
			mediatek,hw-factory-key = <0x11>;
			mediatek,hw-init-map = <0x73 0x0 0x0 0x0 0x0 0x0 0x0 0x0 0x0 0x0 0x0 0x0 0x0 0x0 0x0 0x0 0x0 0x0 0x0 0x0 0x0 0x0 0x0 0x0 0x0 0x0 0x0 0x0 0x0 0x0 0x0 0x0 0x0 0x0 0x0 0x0 0x0 0x0 0x0 0x0 0x0 0x0 0x0 0x0 0x0 0x0 0x0 0x0 0x0 0x0 0x0 0x0 0x0 0x0 0x0 0x0 0x0 0x0 0x0 0x0 0x0 0x0 0x0 0x0 0x0 0x0 0x0 0x0 0x0 0x0 0x0 0x0>;
			mediatek,hw-map-num = <0x48>;
			mediatek,hw-pwrkey = <0x8>;
			mediatek,hw-recovery-key = <0x0>;
			mediatek,hw-rstkey = <0x11>;
			mediatek,key-debounce = <0x400>;
			mediatek,pwkey-gpio-din = <0x0>;
			mediatek,pwrkey-eint-gpio = <0x0>;
			mediatek,sw-pwrkey = <0x74>;
			mediatek,sw-rstkey = <0x72>;
			mediatek,use-extend-type = <0x0>;
			status = "okay";
		};
	};

	fragment@6 {
		target = <0xffffffff>;

		__overlay__ {

			camera_main {
				phandle = <0x38>;
				polling-delay = <0x3e8>;
				polling-delay-passive = <0x0>;
				thermal-sensors = <0x10>;
			};

			camera_main_two {
				phandle = <0x3a>;
				polling-delay = <0x3e8>;
				polling-delay-passive = <0x0>;
				thermal-sensors = <0x12>;
			};

			camera_sub {
				phandle = <0x39>;
				polling-delay = <0x3e8>;
				polling-delay-passive = <0x0>;
				thermal-sensors = <0x11>;
			};
		};
	};

	fragment@7 {
		target = <0xffffffff>;

		__overlay__ {
			atag,videolfb-lcmname = "hx83102j_fhdp_dsi_vdo_120hz_boe_dphy";
		};
	};

	fragment@8 {
		target = <0xffffffff>;

		__overlay__ {
			city = "ROW";
			country = "ROW";
			province = "ROW";
		};
	};

	fragment@9 {
		target = <0xffffffff>;

		__overlay__ {

			dock_pogo {
				compatible = "mediatek,dock_pogo";
				pogo_chg_en = <0xffffffff 0x5c 0x0>;
				pogo_in_det = <0xffffffff 0x5d 0x0>;
				typec_in_det = <0xffffffff 0x5a 0x0>;
			};

			fixedregulator@0 {
				compatible = "regulator-fixed";
				enable-active-high;
				phandle = <0x31>;
				regulator-always-on;
				regulator-max-microvolt = <0x325aa0>;
				regulator-min-microvolt = <0x325aa0>;
				regulator-name = "sdio_fixed_3v3";
			};

			pogo_int {
				compatible = "mediatek,pogo_int";
				interrupt-parent = <0xffffffff>;
				interrupts = <0x5d 0x3 0x5d 0x0>;
			};

			typec_int {
				compatible = "mediatek,typec_int";
				interrupt-parent = <0xffffffff>;
				interrupts = <0x5a 0x3 0x5a 0x0>;
			};
		};
	};
};
